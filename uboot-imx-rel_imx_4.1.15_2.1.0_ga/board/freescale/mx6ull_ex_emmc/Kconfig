## uboot-imx-rel_imx_4.1.15_2.1.0_ga/board/freescale/mx6ull_ex_emmc/Kconfig
```kconfig
if TARGET_MX6ULL_EX_EMMC

config SYS_BOARD
	default "mx6ull_ex_emmc"

config SYS_VENDOR
	default "freescale"

config SYS_SOC
	default "mx6"

config SYS_CONFIG_NAME
	default "mx6ull_ex_emmc"

endif
```

## uboot-imx-rel_imx_4.1.15_2.1.0_ga/board/freescale/mx6ull_my_emmc/Kconfig
```kconfig
if TARGET_MX6ULL_MY_EMMC 

config SYS_BOARD
	default "mx6ull_my_emmc"

config SYS_VENDOR
	default "freescale"

config SYS_CONFIG_NAME
	default "mx6ull_my_emmc"

endif
```
